## west.yml
```yaml
# Copyright (c) 2021 Nordic Semiconductor ASA
# SPDX-License-Identifier: Apache-2.0

manifest:
  self:
    west-commands: scripts/west-commands.yml

  remotes:
    - name: zephyrproject-rtos
      url-base: https://github.com/zephyrproject-rtos
    - name: pigweed
      url-base: https://pigweed.googlesource.com/pigweed
    - name: kokkos
      url-base: https://github.com/kokkos

  projects:
    - name: zephyr
      remote: zephyrproject-rtos
      revision: v4.3.0
      import:
        name-allowlist:
          - cmsis_6
          - hal_stm32
          - hal_espressif

    - name: pigweed
      remote: pigweed
      revision: 0a9a5b62d90ae06303257b0e621456f72d5305d3
      path: modules/pigweed

    - name: mdspan
      remote: kokkos
      revision: stable
      path: modules/mdspan
```
